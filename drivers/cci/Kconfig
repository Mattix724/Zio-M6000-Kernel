## drivers/cci/Kconfig
```kconfig
#
# Compalcomm drivers
#

menuconfig CCI_DRIVERS
        tristate "Compalcomm driver set for KB60/AB60."                                                                              
        default y

if CCI_DRIVERS
config CCI_ANDROID_AVAILABLE_RAM
	int "Available RAM size Android can use in MB (Qualcomm default 212MB)"
	default 212

source "drivers/cci/leds/Kconfig"
source "drivers/cci/backlight/Kconfig"
#source "drivers/cci/lightsensor/Kconfig"
source "drivers/cci/jogball/Kconfig"
source "drivers/cci/keypad_qxdm/Kconfig"
source "drivers/cci/vibrator/Kconfig"
source "drivers/cci/speaker/Kconfig"
source "drivers/cci/usb/Kconfig"
#source "drivers/cci/gsensor/Kconfig"
source "drivers/cci/recovery_mode/Kconfig"
source "drivers/cci/easy_update/Kconfig"

#motoko
source "drivers/cci/acceleration_sensor/Kconfig"
source "drivers/cci/geomagnetic_sensor/Kconfig"
source "drivers/cci/orientation_sensor/Kconfig"
source "drivers/cci/light_sensor/Kconfig"

endif
```

## drivers/cci/acceleration_sensor/Kconfig
```kconfig
config CCI_ACCELERATION_SENSOR
        tristate "YAMAHA acceleration sensor driver"
        default y
        depends on I2C

config INPUT_ACCELERATION_SENSOR_POSITION 
	int "ACCELERATION_SENSOR (KXTE9) Mounting Position on Board" 
	depends on CCI_ACCELERATION_SENSOR
	default "0" 
	help 
		Chip mounting position (pin 1). 
		0: top, upper-left 
		1: top, upper-right 
		2: top, lower-right 
		3: top, lower-left 
		4: bottom, upper-left 
		5: bottom, upper-right 
		6: bottom, lower-right 
		7: bottom, lower-left     
```

## drivers/cci/geomagnetic_sensor/Kconfig
```kconfig
config CCI_GEOMAGNETIC_SENSOR
        tristate "YAMAHA geomagnetic sensor driver"
        default y
        depends on I2C
        
config INPUT_GEOMAGNETIC_SENSOR_POSITION 
	int "GEOMAGNETIC_SENSOR (YAS529) Mounting Position on Board"   
	depends on CCI_GEOMAGNETIC_SENSOR 
	default "1" 
	help 
		Chip mounting position (pin 1). 
		0: top, upper-left 
		1: top, upper-right 
		2: top, lower-right 
		3: top, lower-left 
		4: bottom, upper-left 
		5: bottom, upper-right 
		6: bottom, lower-right 
		7: bottom, lower-left
```

## drivers/cci/orientation_sensor/Kconfig
```kconfig
config CCI_ORIENTATION_SENSOR
        tristate "YAMAHA orientation sensor driver"
        default y
        depends on I2C
```

## drivers/cci/usb/Kconfig
```kconfig
config CCI_USB
	tristate "USB Internet Sharing function call for AB60"
	default y
```

## drivers/char/diag/Kconfig
```kconfig
menu "Diag Support"

config DIAG_CHAR
	tristate "char driver interface and diag forwarding to/from ARM9"
	default m
	depends on USB_ANDROID_DIAG || USB_FUNCTION_DIAG
	depends on ARCH_MSM
	help
	 Char driver interface for diag user space and diag-forwarding to modem ARM and back.

config SLATE_TEST
	bool "SLATE command support"
	default y
	depends on DIAG_CHAR
	help
	 Support SLATE command by diag.
endmenu
```
